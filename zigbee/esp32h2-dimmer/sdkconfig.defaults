## zigbee/esp32h2-dimmer/sdkconfig.defaults
```kconfig
# Zigbee: Router (питание от сети, ретранслирует сеть)
CONFIG_ZB_ENABLED=y
CONFIG_ZB_ZCZR=y
CONFIG_ZB_ED_ROLE=n
# Flash 4MB
CONFIG_ESPTOOLPY_FLASHSIZE_4MB=y
CONFIG_ESPTOOLPY_FLASHSIZE="4MB"
# RMT для LED-ленты (WS2812B)
CONFIG_RMT_ENABLE_DEBUG_LOG=n
CONFIG_NVS_ENCRYPTION=n
```
